## conf/bblayers.conf.sample
```bitbake
# LAYER_CONF_VERSION is increased each time build/conf/bblayers.conf
# changes incompatibly
LCONF_VERSION = "6"

BBPATH = "${TOPDIR}"
BBFILES ?= ""

BBLAYERS ?= " \
  ##OEROOT##/meta \
  ##OEROOT##/meta-yocto \
  ##OEROOT##/meta-yocto-bsp \
  ##OEROOT##/../meta-ivi/meta-ivi \
  ##OEROOT##/../meta-ivi/meta-ivi-bsp \
  ##OEROOT##/../meta-ivi/meta-ivi-demo \
  ##OEROOT##/../meta-openembedded/meta-oe \
  ##OEROOT##/../meta-qt5 \
  ##OEROOT##/../meta-openembedded/meta-ruby \
  "
BBLAYERS_NON_REMOVABLE ?= " \
  ##OEROOT##/meta \
  ##OEROOT##/meta-yocto \
  ##OEROOT##/../meta-ivi/meta-ivi \
  "
```

## conf/layer.conf
```bitbake
# We have a conf and classes directory, add to BBPATH
BBPATH =. "${LAYERDIR}:"

# We have recipes-* directories, add to BBFILES
BBFILES += "${LAYERDIR}/recipes-*/*/*.bb \
            ${LAYERDIR}/recipes-*/*/*.bbappend"

BBFILE_COLLECTIONS += "ividemo"
BBFILE_PATTERN_ividemo = "^${LAYERDIR}/"
BBFILE_PRIORITY_ividemo = "7"

# This should only be incremented on significant changes that will
# cause compatibility issues with other layers
LAYERVERSION_ividemo = "1"

LAYERDEPENDS_ividemo = "ivi"
```

## gdp-src-build/conf/bblayers.conf
```bitbake
# LAYER_CONF_VERSION is increased each time build/conf/bblayers.conf
# changes incompatibly
LCONF_VERSION = "6"

BBPATH = "${TOPDIR}"
BBFILES ?= ""

BBLAYERS ?= " \
  ${TOPDIR}/../poky/meta \
  ${TOPDIR}/../poky/meta-yocto \
  ${TOPDIR}/../poky/meta-yocto-bsp \
  ${TOPDIR}/../meta-ivi/meta-ivi \
  ${TOPDIR}/../meta-ivi/meta-ivi-bsp \
  ${TOPDIR}/../meta-openembedded/meta-oe \
  ${TOPDIR}/../meta-openembedded/meta-filesystems \
  ${TOPDIR}/../meta-openembedded/meta-ruby \
  ${TOPDIR}/../meta-qt5 \
  ${TOPDIR}/../meta-genivi-demo/meta-genivi-demo \
  ${TOPDIR}/../meta-genivi-demo/meta-raspberrypi-gdp \
  ${TOPDIR}/../meta-raspberrypi \
  "

BBLAYERS_NON_REMOVABLE ?= " \
  ${OEROOT}/meta \
  ${OEROOT}/meta-yocto \
  ${OEROOT}/../meta-ivi/meta-ivi \
  "
```

## gdp-src-build/conf/layer.conf
```bitbake
# We have a conf and classes directory, add to BBPATH
BBPATH =. "${LAYERDIR}:"

# We have recipes-* directories, add to BBFILES
BBFILES += "${LAYERDIR}/recipes-*/*/*.bb \
            ${LAYERDIR}/recipes-*/*/*.bbappend"

BBFILE_COLLECTIONS += "genividemo"
BBFILE_PATTERN_genividemo = "^${LAYERDIR}/"
BBFILE_PRIORITY_genividemo = "7"

# This should only be incremented on significant changes that will
# cause compatibility issues with other layers
LAYERVERSION_genividemo = "1"

LAYERDEPENDS_genividemo = "ivi"
```

## gdp-src-build/conf/local.conf
```bitbake
#DL_DIR ?= "${TOPDIR}/downloads"
DISTRO ?= "poky-ivi-systemd"
MACHINE = "intel-corei7-64"
USE_GSTREAMER_1_00="1"
LICENSE_FLAGS_WHITELIST = "commercial"
MACHINE_FEATURES_append = " sgx"
MULTI_PROVIDER_WHITELIST += "virtual/libgl virtual/egl virtual/libgles1 virtual/libgles2"
PREFERRED_PROVIDER_virtual/libgles1 = ""
PREFERRED_PROVIDER_virtual/libgles2 = "gles-user-module"
PREFERRED_PROVIDER_virtual/egl = "libegl"
PREFERRED_PROVIDER_virtual/libgl = ""
PREFERRED_PROVIDER_virtual/mesa = ""
PREFERRED_PROVIDER_libgbm = "libgbm"
PREFERRED_PROVIDER_libgbm-dev = "libgbm"
SDKIMAGE_FEATURES_append = " staticdev-pkgs"
IMAGE_INSTALL_append = " mesa-megadriver"

# INCOMPATIBLE_LICENSE ?= "GPLv3"

# Flag for Faytech Touch Monitor support, '1' will enable kernel driver patch
#USE_FAYTECH_MONITOR = "1"

PACKAGE_CLASSES ?= "package_rpm package_ipk"
EXTRA_IMAGE_FEATURES = "debug-tweaks"
USER_CLASSES ?= "buildstats image-mklibs image-prelink"
PATCHRESOLVE = "noop"

#
# Disk Space Monitoring during the build
#
# Monitor the disk space during the build. If there is less that 1GB of space or less
# than 100K inodes in any key build location (TMPDIR, DL_DIR, SSTATE_DIR), gracefully
# shutdown the build. If there is less that 100MB or 1K inodes, perform a hard abort
# of the build. The reason for this is that running completely out of space can corrupt
# files and damages the build in ways which may not be easily recoverable.
BB_DISKMON_DIRS = "\
    STOPTASKS,${TMPDIR},1G,100K \
    STOPTASKS,${DL_DIR},1G,100K \
    STOPTASKS,${SSTATE_DIR},1G,100K \
    ABORT,${TMPDIR},100M,1K \
    ABORT,${DL_DIR},100M,1K \
    ABORT,${SSTATE_DIR},100M,1K" 

# CONF_VERSION is increased each time build/conf/ changes incompatibly and is used to
# track the version of this file when it was generated. This can safely be ignored if
# this doesn't mean anything to you.
CONF_VERSION = "1"
PREFERRED_VERSION_weston = "1.9.0"
PREFERRED_VERSION_wayland-ivi-extension = "1.9.1"
```

## meta-genivi-dev/meta-erlang/conf/layer.conf
```bitbake
# We have a conf and classes directory, add to BBPATH
BBPATH =. "${LAYERDIR}:"

# We have recipes-* directories, add to BBFILES
BBFILES += "${LAYERDIR}/recipes-*/*/*.bb \
            ${LAYERDIR}/recipes-*/*/*.bbappend"

BBFILE_COLLECTIONS += "genivi-dev-meta-erlang-append"
BBFILE_PATTERN_genivi-dev-meta-erlang-append = "^${LAYERDIR}/"
BBFILE_PRIORITY_genivi-dev-meta-erlang-append = "7"

# This should only be incremented on significant changes that will
# cause compatibility issues with other layers
LAYERVERSION_genivi-dev-meta-erlang-append = "1"

LAYERDEPENDS_genivi-dev-meta-erlang-append = "genivi-dev"

# Uncomment next line and remove this comment later when/if erlang
# gets fixed to include LAYERSERIES_COMPAT
# Unfortunately bitbake refuses to start.  It seems to be:  we depend on a
# layer (as above) and that layer does _not_  provide any compatibility
# information.  It further seems that bitbake assumes "rocko" when nothing
# was specified?) I would have preferred it accepted the situation (with a
# warning) if no *contradicting* compatibility info was given in
# erlang-layer.
#LAYERSERIES_COMPAT_genivi-dev-meta-erlang-append = "sumo"
```

## meta-genivi-dev/meta-genivi-dev/conf/layer.conf
```bitbake
# We have a conf and classes directory, add to BBPATH
BBPATH =. "${LAYERDIR}:"

# We have recipes-* directories, add to BBFILES
BBFILES += "${LAYERDIR}/recipes-*/*/*.bb \
            ${LAYERDIR}/recipes-*/*/*.bbappend"

BBFILE_COLLECTIONS += "genivi-dev"
BBFILE_PATTERN_genivi-dev = "^${LAYERDIR}/"
BBFILE_PRIORITY_genivi-dev = "7"

# This should only be incremented on significant changes that will
# cause compatibility issues with other layers
LAYERVERSION_genivi-dev = "1"

LAYERDEPENDS_genivi-dev = "ivi"

LAYERSERIES_COMPAT_genivi-dev = "sumo"
```

## meta-genivi-dev/meta-genivi-dev/wic/singlepart-noloader.wks
```
# short-description: Single partition rootfs with UUID and no bootloader
# long-description: Creates a partitioned image with a single partition in
# use and does not contain a bootloader.

part / --source rootfs --use-uuid --fstype=ext4 --label root --align 4096
```

## meta-genivi-dev/meta-ivi/conf/layer.conf
```bitbake
# We have a conf and classes directory, add to BBPATH
BBPATH =. "${LAYERDIR}:"

# We have recipes-* directories, add to BBFILES
BBFILES += "${LAYERDIR}/recipes-*/*/*.bb \
            ${LAYERDIR}/recipes-*/*/*.bbappend"

BBFILE_COLLECTIONS += "genivi-dev-meta-ivi-append"
BBFILE_PATTERN_genivi-dev-meta-ivi-append = "^${LAYERDIR}/"
BBFILE_PRIORITY_genivi-dev-meta-ivi-append = "7"

# This should only be incremented on significant changes that will
# cause compatibility issues with other layers
LAYERVERSION_genivi-dev-meta-ivi-append = "1"

LAYERDEPENDS_genivi-dev-meta-ivi-append = "ivi"

LAYERSERIES_COMPAT_genivi-dev-meta-ivi-append = "thud"
```

## meta-genivi-dev/meta-linaro-gdp/meta-linaro-toolchain/conf/layer.conf
```bitbake
BBPATH .= ":${LAYERDIR}"
BBFILES += "\
            ${LAYERDIR}/recipes-*/*/*.bb \
            ${LAYERDIR}/recipes-*/*/*.bbappend \
           "

BBFILE_COLLECTIONS += "linaro-toolchain"
BBFILE_PATTERN_linaro-toolchain := "^${LAYERDIR}/"
BBFILE_PRIORITY_linaro-toolchain = "30"

# do not error out on bbappends for missing recipes
BB_DANGLINGAPPENDS_WARNONLY = "true"
```

## meta-genivi-dev/meta-oic/conf/layer.conf
```bitbake
# We have a conf and classes directory, add to BBPATH
BBPATH .= ":${LAYERDIR}"

# We have recipes-* directories, add to BBFILES
BBFILES += "${LAYERDIR}/recipes-*/*/*.bb \
            ${LAYERDIR}/recipes-*/*/*.bbappend"

BBFILE_COLLECTIONS += "genivi-dev-oic-append"
BBFILE_PATTERN_genivi-dev-oic-append := "^${LAYERDIR}/"
BBFILE_PRIORITY_genivi-dev-oic-append = "7"

LAYERDEPENDS_genivi-dev-oic-append = "oic"
```

## meta-genivi-dev/meta-qt5/conf/layer.conf
```bitbake
# We have a conf and classes directory, add to BBPATH
BBPATH =. "${LAYERDIR}:"

# We have recipes-* directories, add to BBFILES
BBFILES += "${LAYERDIR}/recipes-*/*/*.bb \
            ${LAYERDIR}/recipes-*/*/*.bbappend"

BBFILE_COLLECTIONS += "genivi-dev-meta-qt5-append"
BBFILE_PATTERN_genivi-dev-meta-qt5-append = "^${LAYERDIR}/"
BBFILE_PRIORITY_genivi-dev-meta-qt5-append = "7"

# This should only be incremented on significant changes that will
# cause compatibility issues with other layers
LAYERVERSION_genivi-dev-meta-qt5-append = "1"

LAYERDEPENDS_genivi-dev-meta-qt5-append = "genivi-dev"
```

## meta-genivi-dev/meta-raspberrypi/conf/layer.conf
```bitbake
# We have a conf and classes directory, add to BBPATH
BBPATH =. "${LAYERDIR}:"

# We have recipes-* directories, add to BBFILES
BBFILES += "${LAYERDIR}/recipes-*/*/*.bb \
            ${LAYERDIR}/recipes-*/*/*.bbappend"

BBFILE_COLLECTIONS += "genivi-dev-meta-raspberrypi-append"
BBFILE_PATTERN_genivi-dev-meta-raspberrypi-append = "^${LAYERDIR}/"
BBFILE_PRIORITY_genivi-dev-meta-raspberrypi-append = "7"

# This should only be incremented on significant changes that will
# cause compatibility issues with other layers
LAYERVERSION_genivi-dev-meta-raspberrypi-append = "1"

LAYERDEPENDS_genivi-dev-meta-raspberrypi-append = "genivi-dev"
```

## meta-genivi-dev/meta-rvi/conf/layer.conf
```bitbake
# We have a conf and classes directory, add to BBPATH
BBPATH =. "${LAYERDIR}:"

# We have recipes-* directories, add to BBFILES
BBFILES += "${LAYERDIR}/recipes-*/*/*.bb \
            ${LAYERDIR}/recipes-*/*/*.bbappend"

BBFILE_COLLECTIONS += "genivi-dev-meta-rvi-append"
BBFILE_PATTERN_genivi-dev-meta-rvi-append = "^${LAYERDIR}/"
BBFILE_PRIORITY_genivi-dev-meta-rvi-append = "7"

# This should only be incremented on significant changes that will
# cause compatibility issues with other layers
LAYERVERSION_genivi-dev-meta-rvi-append = "1"

LAYERDEPENDS_genivi-dev-meta-rvi-append = "genivi-dev"
```

## meta-genivi-dev/meta-sdl/conf/layer.conf
```bitbake
# We have a conf and classes directory, add to BBPATH
BBPATH .= ":${LAYERDIR}"

# We have recipes-* directories, add to BBFILES
BBFILES += "${LAYERDIR}/recipes-*/*/*.bb \
	${LAYERDIR}/recipes-*/*/*.bbappend"

BBFILE_COLLECTIONS += "genivi-dev-meta-sdl-append"
BBFILE_PATTERN_genivi-dev-meta-sdl-append = "^${LAYERDIR}/"
BBFILE_PRIORITY_genivi-dev-meta-sdl-append = "10"

LAYERDEPENDS_genivi-dev-meta-sdl-append = "sdl"

LAYERSERIES_COMPAT_genivi-dev-meta-sdl-append = "thud"
```

## meta-genivi-dev/meta-updater-qemux86-64/conf/layer.conf
```bitbake
# We have a conf and classes directory, add to BBPATH
BBPATH =. "${LAYERDIR}:"

# We have recipes-* directories, add to BBFILES
BBFILES += "${LAYERDIR}/recipes-*/*/*.bb \
            ${LAYERDIR}/recipes-*/*/*.bbappend"

BBFILE_COLLECTIONS += "genivi-dev-updater-minnowboard-append"
BBFILE_PATTERN_genivi-dev-updater-minnowboard-append = "^${LAYERDIR}/"
BBFILE_PRIORITY_genivi-dev-updater-minnowboard-append = "8"
```

## meta-genivi-dev/poky/conf/layer.conf
```bitbake
# We have a conf and classes directory, add to BBPATH
BBPATH =. "${LAYERDIR}:"

# We have recipes-* directories, add to BBFILES
BBFILES += "${LAYERDIR}/meta/recipes-*/*/*.bb \
            ${LAYERDIR}/meta/recipes-*/*/*.bbappend"

BBFILE_COLLECTIONS += "genivi-dev-poky-append"
BBFILE_PATTERN_genivi-dev-poky-append = "^${LAYERDIR}/"
BBFILE_PRIORITY_genivi-dev-poky-append = "7"

# This should only be incremented on significant changes that will
# cause compatibility issues with other layers
LAYERVERSION_genivi-dev-poky-append = "1"
LAYERDEPENDS_genivi-dev-poky-append = "genivi-dev"
```
